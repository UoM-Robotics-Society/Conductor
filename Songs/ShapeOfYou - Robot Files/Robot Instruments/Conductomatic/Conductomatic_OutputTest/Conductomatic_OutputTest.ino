#include <SPI.h>

const int MaxNumSongs = 6;  // Number of songs to be loaded
const int NumSongs = 1;     // Number of songs to be loaded
const int RobotMax = 16;    // Max number of robots used

const int Tune1Length = 3;
const int Tune1Tempo = 96;
const int Tune1BeatDenom = 4;

const int Tune2Length = 320;
const int Tune2Tempo = 96;
const int Tune2BeatDenom = 4;

const int Tune3Length = 320;
const int Tune3Tempo = 96;
const int Tune3BeatDenom = 4;

const int Tune4Length = 192;
const int Tune4Tempo = 96;
const int Tune4BeatDenom = 4;

const int Tune5Length = 384;
const int Tune5Tempo = 96;
const int Tune5BeatDenom = 4;

const int Tune6Length = 256;
const int Tune6Tempo = 96;
const int Tune6BeatDenom = 4;


  // Part 1
const unsigned int Tune1[RobotMax][Tune1Length] PROGMEM = {
  {0,0,0},  // Glockobot
  {0,0,0},  // Floppydrives
  {0,0,0},  // Mortimer/Dexter
  {0,0,0},  // LaserKeys/Keyboard
  {0,0,0},  // Plantpotbot
  {0,1,0},  // Woodblock
  {0,0,0},  // Robodrummer
  {0,0,0},  // Tammy the Tamborine
  {0,0,0},  // Beats by Bowker
  {0,0,0},  // Felixatron
  {0,0,0},  // Breakfastbot
  {0,0,0},  // Brickbot
  {0,0,0},  // Strike a Chord
  {0,0,0},  // Mello Cello
  {0,1,0},  // Wav Player (Vocals)
  {0,0,0}}; // Tram Light

  // Part 2
const unsigned int Tune2[RobotMax][Tune2Length] PROGMEM = {
  {1,0,0,0,0,0,0,0,0,0,0,0,0,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0,0},
  {0,0,0,0,0,0,0,0,0,0,0,0,0,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0,0},
  {0,0,0,0,0,0,0,0,0,0,0,0,0,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0,0},
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  {0,0,0,0,0,0,0,0,0,0,0,0,0,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0,0}};

  // Part 3
const unsigned int Tune3[RobotMax][Tune3Length] PROGMEM = {
  {1,0,0,0,0,0,0,0,0,0,0,0,0,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0,0},
  {0,0,0,0,0,0,0,0,0,0,0,0,0,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0,0},
  {0,0,0,0,0,0,0,0,0,0,0,0,0,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0,0},
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  {1,0,0,1,0,0,1,0,1,0,0,1,0,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0,0}};

  // Part 4
const unsigned int Tune4[RobotMax][Tune4Length] PROGMEM = {
  {1,0,0,0,0,0,0,0,0,0,0,0,0,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0,0},
  {0,0,0,0,0,0,0,0,0,0,0,0,0,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0,0},
  {0,0,0,0,0,0,0,0,0,0,0,0,0,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0,0},
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  {0,0,0,0,0,0,0,0,0,0,0,0,0,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0,0}};

  // Part 5
const unsigned int Tune5[RobotMax][Tune5Length] PROGMEM = {
  {1,0,0,0,0,0,0,0,0,0,0,0,0,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0,0},
  {0,0,0,0,0,0,0,0,0,0,0,0,0,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0,0},
  {0,0,0,0,0,0,0,0,0,0,0,0,0,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0,0},
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  {0,0,0,0,0,0,0,0,0,0,0,0,0,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0,0}};

  // Part 6
const unsigned int Tune6[RobotMax][Tune6Length] PROGMEM = {
  {1,0,0,0,0,0,0,0,0,0,0,0,0,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0,0},
  {0,0,0,0,0,0,0,0,0,0,0,0,0,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0,0},
  {0,0,0,0,0,0,0,0,0,0,0,0,0,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0,0},
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  {0,0,0,0,0,0,0,0,0,0,0,0,0,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0,0}};



// Create array to store information about songs
int Tune_Info[MaxNumSongs][3];

// Create program variables
int On_Signal;    // Used to track conductor
unsigned int Load_Robot;

int BeatCount = 0; // Used to index Tune array
int RobotCount = 0; // Used to index Tune array
int SongCount = 0;

const int start_delay = 0;

const int Robot_On = 1;
const int Robot_Off = 0;


// define I/O pins  
const int SR_Latch_Pin = 49; // latch shift register ( Wire)
const int SR_Reset_Pin = 47; // reset shift register ( Wire)
const int SR_LClK_Pin = 48;

//For SPI on UNO, Reset - 8, Latch - 9, MOSI - 11 and SCK - 13 and LClk - 7
//For SPI on MEGA, Reset - 47, Latch - 49, MOSI - 51 and SCK - 52 and LClk - 48

const int On_Button = 4;          // signal from graphine conductor, set low with output pin ( Wire)
const int On_Button_Light = 2;  // Turn on light in switch when the conductor is ready to start a song ( Wire)

// define Shift Register Length
const int SR_Number = 2;  // Number of shift register boards
const int SR_Length = 8;  // Length of each shift register 

// define robot output number
// Output Number = Robot Number 
//int SR_Output[SR_Number][SR_Length] = {{0,1,2,3,4,5,6,7},{8,9,10,11,12,13,14,15}};
int SR_Output[SR_Number][SR_Length] = {{15,14,13,12,11,10,9,8},{7,6,5,4,3,2,1,0}};

byte SR_Note_Data[SR_Number]; // Data to be passed to the shift registers


// Shift Register Output patterns, Relay is activated by low signal
byte      All_OFF = B11111111;
byte      All_ON = B00000000;
byte      On_1 = B11110110;


// Timing check variables
unsigned long sr_start_time= 0;
unsigned long sr_stop_time= 0;

unsigned long min_us= 240000000;
long int Beat_Time;

int TotalLength;
unsigned long part_start_time = 0;
unsigned long part_tempo = 0;
unsigned long part_stop_time = 0;
unsigned long song_start_time = 0;
unsigned long song_tempo = 0;
unsigned long song_stop_time = 0;

float part_time = 0;
float song_time = 0;

  // Timing Variables
volatile unsigned int Timer1_Beat_Count =0; // Used to set Timer 1 to correct tempo
volatile unsigned int Next_Beat = 0; // Flag to move to next beat, set by Timer 1 Interrupt



void setup() 
{
     // Populate array to store song information
    Tune_Info[0][0] =  Tune1Length;
    Tune_Info[0][1] =  Tune1Tempo;
    Tune_Info[0][2] =  Tune1BeatDenom;
    Tune_Info[1][0] =  Tune2Length;
    Tune_Info[1][1] =  Tune2Tempo;
    Tune_Info[1][2] =  Tune2BeatDenom;
    Tune_Info[2][0] =  Tune3Length;
    Tune_Info[2][1] =  Tune3Tempo;
    Tune_Info[2][2] =  Tune3BeatDenom;
    Tune_Info[3][0] =  Tune4Length;
    Tune_Info[3][1] =  Tune4Tempo;
    Tune_Info[3][2] =  Tune4BeatDenom;
    Tune_Info[4][0] =  Tune5Length;
    Tune_Info[4][1] =  Tune5Tempo;
    Tune_Info[4][2] =  Tune5BeatDenom;
    Tune_Info[5][0] =  Tune6Length;
    Tune_Info[5][1] =  Tune6Tempo;
    Tune_Info[5][2] =  Tune6BeatDenom;

    TotalLength = Tune1Length + Tune2Length + Tune3Length + Tune4Length + Tune5Length + Tune6Length;

    pinMode(SR_Latch_Pin, OUTPUT);
    pinMode(SR_Reset_Pin, OUTPUT);
    pinMode(SR_LClK_Pin, OUTPUT);
    pinMode(On_Button, INPUT_PULLUP);
    pinMode(On_Button_Light, OUTPUT);
    
    digitalWrite(SR_Latch_Pin, LOW);
    digitalWrite(SR_Reset_Pin, HIGH);
    digitalWrite(SR_LClK_Pin, LOW);
    digitalWrite(On_Button, HIGH);
    digitalWrite(On_Button_Light, LOW);

    // Start USB Serial for monitoring
    Serial.begin(9600);   
    Serial.println("USB Working!");
    
    SPI.begin();
    SPI.beginTransaction(SPISettings(2000000, MSBFIRST, SPI_MODE0)); // 100kHz Shift Clock
    
    Reset_SR(); 
}

void loop() 
{
    Serial.print("Number of Notes: ");
    Serial.print(Tune_Info[0][0]);
    Serial.print(", ");
    Serial.print(Tune_Info[1][0]);
    Serial.print(", ");
    Serial.print(Tune_Info[2][0]);
    Serial.print(", ");
    Serial.print(Tune_Info[3][0]);
    Serial.print(", ");
    Serial.print(Tune_Info[4][0]);
    Serial.print(", ");
    Serial.println(Tune_Info[5][0]);
    
    Serial.print("Tempo(Bpm): ");
    Serial.print(Tune_Info[0][1]);
    Serial.print(", ");
    Serial.print(Tune_Info[1][1]);
    Serial.print(", ");
    Serial.print(Tune_Info[2][1]);
    Serial.print(", ");
    Serial.print(Tune_Info[3][1]);
    Serial.print(", ");
    Serial.print(Tune_Info[4][1]);
    Serial.print(", ");
    Serial.println(Tune_Info[5][1]);
    
    Serial.print("Beat Denomination: ");
    Serial.print(Tune_Info[0][2]);
    Serial.print(", ");
    Serial.print(Tune_Info[1][2]);
    Serial.print(", ");
    Serial.print(Tune_Info[2][2]);
    Serial.print(", ");
    Serial.print(Tune_Info[3][2]);
    Serial.print(", ");
    Serial.print(Tune_Info[4][2]);
    Serial.print(", ");
    Serial.println(Tune_Info[5][2]);

    Serial.print("Total Length: ");
    Serial.println(TotalLength);
    Serial.println();
    
    Serial.println("Ready to play, waiting for On Signal");
    Serial.println();
    //digitalWrite(On_Button_Light, HIGH);  // Turn button light on
    
    On_Signal = 1;
    while (On_Signal > 0)
    {
        On_Signal = digitalRead(On_Button); // Wait for Graphene ON (LOW)
    }

    //digitalWrite(On_Button_Light, LOW);   // Turn button light off
    song_start_time = micros();
    delay(start_delay);
    Serial.println("Song Start");
    
    Beat_Time = (1/(Tune_Info[SongCount][1]/60.0))/Tune_Info[SongCount][2]*1000000.0;
    Serial.print("Beat Time (s): ");
    Serial.println(Beat_Time/1000000.0);
    Serial.println();

    Next_Beat = 0;      // Reset Flag ADDED keep here as interupt can change it
    Start_Beat_Timer();

    for(SongCount = 0; SongCount < NumSongs; SongCount++)
    {   
           part_start_time = micros();
          
          //Serial.print("Song: ");
          //Serial.println(SongCount);

          for (BeatCount=0; BeatCount < Tune_Info[SongCount][0]; BeatCount++)
          {
                //Serial.print("Beat: ");
                //Serial.println(BeatCount);
                
                for (RobotCount=0; RobotCount < RobotMax; RobotCount++)
                {  
                     //Serial.print("Robot: ");
                     //Serial.println(RobotCount);

                      if(SongCount == 0)
                      {
                          Load_Robot = pgm_read_byte(&Tune1[RobotCount][BeatCount]);
                      }
                      if(SongCount == 1)
                      {
                          Load_Robot = pgm_read_byte(&Tune2[RobotCount][BeatCount]);
                      }
                      if(SongCount == 2)
                      {
                          Load_Robot = pgm_read_byte(&Tune3[RobotCount][BeatCount]);
                      }
                      if(SongCount == 3)
                      {
                          Load_Robot = pgm_read_byte(&Tune4[RobotCount][BeatCount]);
                      }
                      if(SongCount == 4)
                      {
                          Load_Robot = pgm_read_byte(&Tune5[RobotCount][BeatCount]);
                      }  
                      if(SongCount == 5)
                      {
                          Load_Robot = pgm_read_byte(&Tune6[RobotCount][BeatCount]);
                      }  
                                         
                      //Serial.print("Load_Robot: ");
                      //Serial.println(Load_Robot);
                      
                      Load_Beat(RobotCount,Load_Robot);   
                }
                
                Serial.print("Note_Data: ");
                Serial.print(SR_Note_Data[0]);
                Serial.print(", ");
                Serial.println(SR_Note_Data[1]);

                Play_Beat();
                
                //Serial.println();

                while (Next_Beat < 1)
                {
                  // Waitfor Beat Timer 
                }
          
                // Turn OFF LEDs
                Reset_SR();
                Next_Beat = 0;
          }

          while (On_Signal < 1)
          {
              On_Signal = digitalRead(On_Button); //  Wait for Graphene signal OFF (HIGH)
          }

          part_stop_time = micros();
        
    
          //-----------------
          // calculate tempo
              
              
          part_time = (part_stop_time-part_start_time)/1000000.0; 
          part_tempo = ((Tune_Info[SongCount][0]/Tune_Info[SongCount][2])/part_time)*60.0;
    
          // display results   
          Serial.print("Part Number: ");
          Serial.println(SongCount);
          
          Serial.print("Part Time (s): ");
          Serial.println(part_time);
          Serial.print("Part Tempo (bpm): ");
          Serial.println(part_tempo);
          
          Serial.print("Shift Register Load Time: ");  
          Serial.println(sr_stop_time-sr_start_time);
           
          Serial.println();

    }

    song_stop_time = micros();

    song_time = (song_stop_time-song_start_time)/1000000.0; 
    song_tempo = ((TotalLength/Tune_Info[0][2])/song_time)*60.0;
    
    Serial.print("Song Time (s): ");
    Serial.println(song_time);
    Serial.print("Song Tempo (bpm): ");
    Serial.println(song_tempo);
      
      Serial.println("-----------------------------------------------------------------");
}

// --------------------------------------------------------------------------------------

// Load note functions

void Load_Beat(unsigned char RobotNum, unsigned char Play) 
{
    for(int j = 0; j < SR_Number; j++)
    {
        for(int i = 0; i < SR_Length; i++)
        {
            if(SR_Output[j][i] == RobotNum)
            {
                if(Play == 1)
                { 
                    SR_Note_Data[j] = SR_Note_Data[j] - (1<<i);
                }
            }
        }
        
    }
}


void Play_Beat() 
{
    sr_start_time=micros();

    Load_Notes_SR();
    Set_SR();
    Clear_SR_Note_Data();
    
    sr_stop_time=micros();
}

void Load_Notes_SR() 
{
  //digitalWrite(SR_Latch_Pin, LOW);
  for(int i=0; i < SR_Number; i++)
  {
      SPI.transfer(SR_Note_Data[i]);  
  }
}

void Set_SR() 
{
    digitalWrite(SR_LClK_Pin, HIGH);
    delayMicroseconds(2);
    digitalWrite(SR_LClK_Pin, LOW);
}

void Reset_SR() 
{
    digitalWrite(SR_Reset_Pin, LOW);
    delayMicroseconds(2);
    digitalWrite(SR_Reset_Pin, HIGH);

    Clear_SR_Note_Data();
    Load_Notes_SR();
    Set_SR();
}

void Clear_SR_Note_Data()
{
  for ( int i=0; i < SR_Number; i++)
  {
      SR_Note_Data[i] = All_OFF;    // clear all bits
  }
}

// Functions for interrupt timer

void Start_Beat_Timer() 
{
  //Serial.println(Beat_Time);
  noInterrupts();           // disable all interrupts
  TCCR1A = 0;
  TCCR1B = 0;
  TIMSK1 |= (1 << TOIE1); // enable timer overflow interrupt
  TCNT1 = Timer1_Beat_Count;   // preload timer
  TCCR1B |= (1 << CS12);    // Sets 256 prescaler 16 uSec counts
  Timer1_Beat_Count = (65536 -(Beat_Time/16));   // preload timer 65536-(416666/16) = 39494
  interrupts();             // enable all interrupts
}

ISR(TIMER1_OVF_vect)        // interrupt service routine 
{
  TCNT1 = Timer1_Beat_Count;   // Reload timer1 with beacount
  Next_Beat= 1;
}
