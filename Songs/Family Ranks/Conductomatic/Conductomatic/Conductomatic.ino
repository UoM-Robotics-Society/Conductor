#include <SPI.h>

const int MaxNumSongs = 1;  // Number of songs to be loaded
const int NumSongs = 1;     // Number of songs to be loaded
const int RobotMax = 16;    // Max number of robots used

const int Tune1Length = 961;
const int Tune1Tempo = 140;
const int Tune1BeatDenom = 4; // Should be 1 but changed to 2 so that the last part of each beat can be used to turn all of the instruments off

const unsigned int Tune1[RobotMax][Tune1Length] PROGMEM = {
  {0,1,0,0,0,0,0,0,0,0,0,0,0,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0,0},
  {0,0,0,0,0,0,0,0,0,0,0,0,0,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0,0},
  {0,1,0,1,0,0,1,0,1,0,0,1,0,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0,0},
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  {0,0,0,0,0,0,0,0,0,0,0,0,0,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0,0}};

// Create array to store information about songs
int Tune_Info[MaxNumSongs][3];

// Create program variables
int On_Signal;    // Used to track conductor
unsigned int Load_Robot;

int BeatCount = 0; // Used to index Tune array
int RobotCount = 0; // Used to index Tune array
int SongCount = 0;

const int start_delay = 0;

const int Robot_On = 1;
const int Robot_Off = 0;


// define I/O pins  
const int SR_Latch_Pin = 49; // latch shift register ( Wire)
const int SR_Reset_Pin = 47; // reset shift register ( Wire)
const int SR_LClK_Pin = 48;

//For SPI on UNO, Reset - 8, Latch - 9, MOSI - 11 and SCK - 13 and LClk - 7
//For SPI on MEGA, Reset - 47, Latch - 49, MOSI - 51 and SCK - 52 and LClk - 48

const int On_Button = 4;          // signal from graphine conductor, set low with output pin ( Wire)
//const int On_Button_Light = 2;  // Turn on light in switch when the conductor is ready to start a song ( Wire)



// define Shift Register Length
const int SR_Number = 2;  // Number of shift register boards
const int SR_Length = 8;  // Length of each shift register 

// define robot output number
// Output Number = Robot Number 
//int SR_Output[SR_Number][SR_Length] = {{0,1,2,3,4,5,6,7},{8,9,10,11,12,13,14,15}};
int SR_Output[SR_Number][SR_Length] = {{15,14,13,12,11,10,9,8},{7,6,5,4,3,2,1,0}};

byte SR_Note_Data[SR_Number]; // Data to be passed to the shift registers


// Shift Register Output patterns, Relay is activated by low signal
byte      All_OFF = B11111111;
byte      All_ON = B00000000;
byte      On_1 = B11110110;


// Timing check variables
unsigned long sr_start_time= 0;
unsigned long sr_stop_time= 0;

unsigned long min_us= 240000000;
long int Beat_Time;

unsigned long part_start_time = 0;
unsigned long part_tempo = 0;
unsigned long part_stop_time = 0;

float part_time = 0;

  // Timing Variables
volatile unsigned int Timer1_Beat_Count =0; // Used to set Timer 1 to correct tempo
volatile unsigned int Next_Beat = 0; // Flag to move to next beat, set by Timer 1 Interrupt



void setup() 
{
     // Populate array to store song information
    Tune_Info[0][0] =  Tune1Length;
    Tune_Info[0][1] =  Tune1Tempo;
    Tune_Info[0][2] =  Tune1BeatDenom;
    
    pinMode(SR_Latch_Pin, OUTPUT);
    pinMode(SR_Reset_Pin, OUTPUT);
    pinMode(SR_LClK_Pin, OUTPUT);
    pinMode(On_Button, INPUT_PULLUP);
    
    digitalWrite(SR_Latch_Pin, LOW);
    digitalWrite(SR_Reset_Pin, HIGH);
    digitalWrite(SR_LClK_Pin, LOW);
    digitalWrite(On_Button, HIGH);

    // Start USB Serial for monitoring
    Serial.begin(9600);   
    Serial.println("USB Working!");
    
    SPI.begin();
    SPI.beginTransaction(SPISettings(2000000, MSBFIRST, SPI_MODE0)); // 100kHz Shift Clock
    
    Reset_SR(); 
}

void loop() 
{
    Serial.print("Number of Notes: ");
    Serial.println(Tune_Info[0][0]);
   
    Serial.print("Tempo(Bpm): ");
    Serial.println(Tune_Info[0][1]);
       
    Serial.print("Beat Denomination: ");
    Serial.println(Tune_Info[0][2]);

    for(SongCount = 0; SongCount < NumSongs; SongCount++)
    {
          Serial.println("Ready to play, waiting for On Signal");
          Serial.println();
          
          //On_Signal = 1;
          On_Signal = 0;
          while (On_Signal > 0)
          {
              On_Signal = digitalRead(On_Button); // Wait for Graphene ON (LOW)
          }
      
          delay(start_delay);
          Serial.println("Song Start");

          Beat_Time = (1/(Tune_Info[SongCount][1]/60.0))/Tune_Info[SongCount][2]*1000000.0;
          Serial.print("Beat Time (s): ");
          Serial.println(Beat_Time/1000000.0);
          Serial.println(); 

          Next_Beat = 0;      // Reset Flag ADDED keep here as interupt can change it
          Start_Beat_Timer();
          
          part_start_time = micros();
          
          //Serial.print("Song: ");
          //Serial.println(SongCount);

          for (BeatCount=0; BeatCount < Tune_Info[SongCount][0]; BeatCount++)
          {
                //Serial.print("Beat: ");
                //Serial.println(BeatCount);

                for (RobotCount=0; RobotCount < RobotMax; RobotCount++)
                {  
                      //Serial.print("Robot: ");
                      //Serial.println(RobotCount);

                      if(SongCount == 0)
                      {
                          Load_Robot = pgm_read_byte(&Tune1[RobotCount][BeatCount]);
                      }
                                                              
                      //Serial.print("Load_Robot: ");
                      //Serial.println(Load_Robot);
                      
                      Load_Beat(RobotCount,Load_Robot);   
                }
                
                //Serial.print("Note_Data: ");
                //Serial.print(SR_Note_Data[0]);
                //Serial.print(", ");
                //Serial.println(SR_Note_Data[1]);

                Play_Beat();
                
                //Serial.println();

                while (Next_Beat < 1)
                {
                  // Waitfor Beat Timer 
                }
          
                // Turn OFF LEDs
                Reset_SR();
                Next_Beat = 0;

                //Serial.println("Last Part of Beat");
                //Serial.println();

                while (Next_Beat < 1)
                {
                  // Waitfor Beat Timer 
                }
          
                // Turn OFF LEDs
                Reset_SR();
                Next_Beat = 0;
          }

          while (On_Signal < 1)
          {
              On_Signal = digitalRead(On_Button); //  Wait for Graphene signal OFF (HIGH)
          }

          part_stop_time = micros();
        
    
          //-----------------
          // calculate tempo
              
              
          part_time = (part_stop_time-part_start_time)/1000000.0; 
          part_tempo = ((Tune_Info[SongCount][0]/Tune_Info[SongCount][2])/part_time)*60.0;
    
          // display results   
          Serial.print("Part Number: ");
          Serial.println(SongCount+1);
          
          Serial.print("Part Time (s): ");
          Serial.println(part_time);
          Serial.print("Part Tempo (bpm): ");
          Serial.println(part_tempo);
          
          Serial.print("Shift Register Load Time: ");  
          Serial.println(sr_stop_time-sr_start_time);
           
          Serial.println();

    }

      Serial.println("-----------------------------------------------------------------");
}

// --------------------------------------------------------------------------------------

// Load note functions

void Load_Beat(unsigned char RobotNum, unsigned char Play) 
{
    for(int j = 0; j < SR_Number; j++)
    {
        for(int i = 0; i < SR_Length; i++)
        {
            if(SR_Output[j][i] == RobotNum)
            {
                if(Play == 1)
                { 
                    SR_Note_Data[j] = SR_Note_Data[j] - (1<<i);
                }
            }
        }
        
    }
}


void Play_Beat() 
{
    sr_start_time=micros();

    Load_Notes_SR();
    Set_SR();
    Clear_SR_Note_Data();
    
    sr_stop_time=micros();
}

void Load_Notes_SR() 
{
  //digitalWrite(SR_Latch_Pin, LOW);
  for(int i=0; i < SR_Number; i++)
  {
      SPI.transfer(SR_Note_Data[i]);  
  }
}

void Set_SR() 
{
    digitalWrite(SR_LClK_Pin, HIGH);
    delayMicroseconds(2);
    digitalWrite(SR_LClK_Pin, LOW);
}

void Reset_SR() 
{
    digitalWrite(SR_Reset_Pin, LOW);
    delayMicroseconds(2);
    digitalWrite(SR_Reset_Pin, HIGH);

    Clear_SR_Note_Data();
    Load_Notes_SR();
    Set_SR();
}

void Clear_SR_Note_Data()
{
  for ( int i=0; i < SR_Number; i++)
  {
      SR_Note_Data[i] = All_OFF;    // clear all bits
  }
}

// Functions for interrupt timer

void Start_Beat_Timer() 
{
  //Serial.println(Beat_Time);
  noInterrupts();           // disable all interrupts
  TCCR1A = 0;
  TCCR1B = 0;
  TIMSK1 |= (1 << TOIE1); // enable timer overflow interrupt
  TCNT1 = Timer1_Beat_Count;   // preload timer
  TCCR1B |= (1 << CS12);    // Sets 256 prescaler 16 uSec counts
  Timer1_Beat_Count = (65536 -(Beat_Time/16));   // preload timer 65536-(416666/16) = 39494
  interrupts();             // enable all interrupts
}

ISR(TIMER1_OVF_vect)        // interrupt service routine 
{
  TCNT1 = Timer1_Beat_Count;   // Reload timer1 with beacount
  Next_Beat= 1;
}
